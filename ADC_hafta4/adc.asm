INCLUDE<P16F877A.INC>
__config H'3F31'


ORG 0X00
goto anaprogram
ORG 0X04

KESME
BTFSS PIR1,ADIF
RETFIE
BCF PIR1,ADIF
BANKSEL ADRESH
MOVF ADRESH,W
MOVWF PORTB
BANKSEL ADRESL
MOVF ADRESL,W
BANKSEL PORTC
MOVWF PORTC
BANKSEL ADCON0
BSF ADCON0,GO
RETFIE


anaprogram
CLRF PORTB
CLRF PORTC
BANKSEL TRISA
CLRF TRISB
CLRF TRISC
MOVLW D'255'
MOVWF TRISA

MOVLW B'01000000'		;Porta analog giriþ yapýldý sola dayalý
MOVWF ADCON1

BANKSEL PIR1
BCF PIR1,ADIF
BSF INTCON,GIE
BSF INTCON,PEIE

MOVLW B'00011001'		;kanal 3 secildi adon=1
MOVWF ADCON0

BANKSEL PIE1
BSF PIE1,ADIE
BANKSEL ADCON0
BSF ADCON0,GO		;adc cevirmeye basladý

KESMEBEKLE
GOTO KESMEBEKLE
END
