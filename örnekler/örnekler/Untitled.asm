#INCLUDE<P16F877A.INC>
__CONFIG H'3F31'
SAYI1 EQU 0X23
SAYI2 EQU 0X24
ORG 0X00
GOTO AYAR

ORG 0X04
CALL KESME


AYAR
BANKSEL TRISA
MOVLW D'255'
MOVWF TRISA
CLRF TRISB
CLRF TRISC
CLRF TRISD
BANKSEL PORTB
CLRF PORTB
CLRF PORTC
CLRF PORTD


BANKSEL ADCON1
MOVLW B'00000000'
MOVWF ADCON1



KONTROL
BANKSEL ADCON0
MOVLW B'00101001'
MOVWF ADCON0

BSF ADCON0,GO

BTFSC ADCON0,GO
GOTO $-1
BANKSEL ADRESH
MOVF ADRESH,W
BANKSEL SAYI1
MOVWF SAYI1

;BANKSEL PORTB
;MOVWF PORTB
;BANKSEL ADRESL
;MOVF ADRESL,W
;BANKSEL PORTC
;MOVWF PORTC

BANKSEL ADCON0
MOVLW B'00110001'
MOVWF ADCON0
BSF ADCON0,GO

BTFSC ADCON0,GO
GOTO $-1
BANKSEL ADRESH
MOVF ADRESH,W
BANKSEL SAYI2
MOVWF SAYI2

BANKSEL SAYI1
MOVF SAYI1,W
BANKSEL PORTB
MOVWF PORTB
BANKSEL SAYI2
MOVF SAYI2,W
BANKSEL PORTC
MOVWF PORTC

MOVF SAYI1,W
SUBWF SAYI2,W
BTFSC STATUS,Z
GOTO ESIT
BTFSC STATUS,C
GOTO BUYUK
GOTO KUCUK 
ESIT
CLRF PORTD
BSF PORTD,1

BSF ADCON0,GO
GOTO KONTROL
KUCUK
CLRF PORTD
BSF PORTD,0
BSF ADCON0,GO
GOTO KONTROL
BUYUK
CLRF PORTD
BSF PORTD,2
BSF ADCON0,GO
GOTO KONTROL






KESME



END