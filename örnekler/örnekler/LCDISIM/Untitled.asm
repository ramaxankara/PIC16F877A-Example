#INCLUDE <P16F877A.INC>
__CONFIG 3F31
L1 EQU 0X20
L2 EQU 0X21
SATIR EQU 0X22
S1 EQU 0X23
S2 EQU 0X24
ORG 0X00

BANKSEL TRISB
CLRF TRISB
CLRF TRISC
MOVLW 0X02
CALL KOMUT
MOVLW 0X38
CALL KOMUT 
MOVLW 0X0C
CALL KOMUT
MOVLW 0X80
CALL KOMUT
BANKSEL PORTB



GOTO DONGU
KOMUT
BANKSEL PORTC
MOVWF PORTC
BCF PORTB,4
BSF PORTB,6
CALL GECIKME
BCF PORTB,6
RETURN

KARAKTER
BANKSEL PORTC
MOVWF PORTC
BSF PORTB,4
BSF PORTB,6
CALL GECIKME
BCF PORTB,6
RETURN



DONGU

MOVF L1,W
CALL ISIM
CALL KARAKTER
INCF L1,F
MOVF L1,W
SUBLW D'6'
BTFSS STATUS,Z
GOTO DONGU
MOVLW 0XC0
CALL KOMUT

DON
MOVF L2,W
CALL SOYISIM
CALL KARAKTER
INCF L2,F
MOVF L2,W
SUBLW D'2'
BTFSS STATUS,Z
GOTO DON
GOTO BOS
GOTO DONGU

BOS

GOTO BOS
ISIM
ADDWF PCL,F
RETLW 'M'
RETLW 'E'
RETLW 'H'
RETLW 'M'
RETLW 'E'
RETLW 'T'
RETURN
SOYISIM
ADDWF PCL,F
RETLW 'A'
RETLW 'K'
RETURN

GECIKME
MOVLW 0XFF
MOVWF S1
DHH
MOVLW 0XFF
MOVWF S2
DHH2
DECFSZ S2,F
GOTO DHH2
DECFSZ S1,F
GOTO DHH
RETURN



END