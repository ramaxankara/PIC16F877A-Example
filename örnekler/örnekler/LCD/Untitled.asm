#INCLUDE<P16F877A.INC>
__CONFIG H'3F31'
SAYI1 EQU 0X23
SAYI2 EQU 0X24
SAYI3 EQU 0X25
SAYI4 EQU 0X26
ORG 0X00
GOTO AYAR



AYAR
BANKSEL TRISA
MOVLW D'255'
MOVWF TRISA
CLRF TRISB
CLRF TRISC
CLRF TRISD
BANKSEL PORTB
CLRF PORTB
CLRF PORTC
CLRF PORTD


BANKSEL ADCON1
MOVLW B'00000000'
MOVWF ADCON1

MOVLW 0X02
CALL KOMUTYAZ
MOVLW 0X38
CALL KOMUTYAZ
MOVLW 0X0C
CALL KOMUTYAZ

KONTROL
BANKSEL ADCON0
MOVLW B'00101001'
MOVWF ADCON0

BSF ADCON0,GO

BTFSC ADCON0,GO
GOTO $-1
BANKSEL ADRESH
MOVF ADRESH,W
BANKSEL SAYI1
MOVWF SAYI1


BANKSEL ADCON0
MOVLW B'00110001'
MOVWF ADCON0
BSF ADCON0,GO

BTFSC ADCON0,GO
GOTO $-1
BANKSEL ADRESH
MOVF ADRESH,W
BANKSEL SAYI2
MOVWF SAYI2

MOVF SAYI1,W
SUBWF SAYI2,W
BTFSC STATUS,Z
GOTO ESIT
BTFSC STATUS,C
GOTO BUYUK
GOTO KUCUK 

ESIT
MOVLW 0X80
CALL KOMUTYAZ
MOVLW'E'
CALL KARAKTERYAZ
CALL GECIKME
BSF ADCON0,GO
GOTO KONTROL


KUCUK
MOVLW 0X80
CALL KOMUTYAZ
MOVLW 'K'
CALL KARAKTERYAZ
CALL GECIKME

BSF ADCON0,GO
GOTO KONTROL


BUYUK
MOVLW 0X80
CALL KOMUTYAZ
MOVLW 'B'
CALL KARAKTERYAZ
CALL GECIKME

BSF ADCON0,GO
GOTO KONTROL



KOMUTYAZ
BANKSEL PORTC
MOVWF PORTC
BCF PORTB,4
BSF PORTB,6
CALL GECIKME
BCF PORTB,6
RETURN

KARAKTERYAZ
BANKSEL PORTC
MOVWF PORTC
BSF PORTB,4
BSF PORTB,6
CALL GECIKME
BCF PORTB,6
RETURN

GECIKME
MOVLW 0XFF
MOVWF SAYI3

GECIK1
MOVLW 0XFF
MOVWF SAYI4

DECFSZ SAYI4,F
GOTO $-1
DECFSZ SAYI3,F
GOTO GECIK1
RETURN

END