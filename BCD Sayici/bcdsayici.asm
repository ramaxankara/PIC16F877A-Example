#INCLUDE <P16F877A.INC>

ORG 0X00
goto anaprogram

ORG 0X04

kesme
retfie

anaprogram
BSF STATUS,RP0 ;1 BANKA GEÇTÝK
MOVLW 0X06
MOVWF ADCON1
MOVLW 0xCF
MOVWF TRISA

BANKSEL TRISB
CLRF TRISB ;PORTB YÝ CIKIS YAPTIK
BANKSEL PORTB
CLRF PORTB

DÜZEN
BTFSS PORTA,0
GOTO KONTROL
GOTO DOKUZMU


DOKUZMU
MOVLW D'9'
SUBWF PORTB,0
BTFSS STATUS,Z
GOTO ARTIR
MOVLW D'0'
MOVWF PORTB
GOTO DONGU


ARTIR
INCF PORTB,1
GOTO DONGU
 

DONGU
BTFSS PORTA,0   ;Burda butona basýlý kalma süresi oldugunca artýrýlan
GOTO DÜZEN		;deðer kalacak çünkü komut mikro saniyeler ile iþleniyor
GOTO DONGU 		;bu yüzden bekleme olmasý lazým

KONTROL
BTFSS PORTA,1
GOTO DÜZEN
GOTO SIFIRMI


SIFIRMI
BTFSC PORTB,0
GOTO AZALT
BTFSC PORTB,1
GOTO AZALT
BTFSC PORTB,2
GOTO AZALT
BTFSC PORTB,3
GOTO AZALT
MOVLW D'9'
MOVWF PORTB
GOTO DONGU2

AZALT
DECF PORTB,1
GOTO DONGU2


DONGU2
BTFSS PORTA,1
GOTO DÜZEN
GOTO DONGU2



END




