INCLUDE<P16F877A.INC>


ARA EQU 0X29
TEMP EQU 0X23
TEMP2 EQU 0X27
TEMP3 EQU 0X28
SAY1 EQU 0X24
SAY2 EQU 0X25
SAY3 EQU 0X26
ZAMAN EQU 0X30
ORG 0X04
anaprogram
CLRF SAY1
CLRF SAY2
CLRF SAY3
BANKSEL TRISB
CLRF TRISB
CLRF TRISD
BANKSEL PORTB
MOVLW D'246'
MOVWF TEMP

BASLA
MOVLW D'100'
SUBWF TEMP,F
BTFSC STATUS,C
GOTO y
GOTO BASLA2

y
MOVF TEMP,W
MOVWF TEMP2
INCF SAY1
GOTO BASLA


BASLA2
MOVLW D'10'
SUBWF TEMP2,F
BTFSC STATUS,C
GOTO ONLAR
GOTO BASLA3

ONLAR
MOVF TEMP2,W
MOVWF TEMP3
INCF SAY2
GOTO BASLA2

BASLA3
MOVF TEMP3,W
MOVWF SAY3


CALL komutgönder
CALL karaktergönder

DONGU
GOTO DONGU


komutgönder
MOVLW 0X02
CALL komutyaz
MOVLW 0X28
CALL komutyaz
MOVLW 0X0C
CALL komutyaz
MOVLW 0X82
CALL komutyaz
return

karaktergönder
MOVF SAY1,W
ADDLW D'48'
CALL karakteryaz
MOVF SAY2,W
ADDLW D'48'
CALL karakteryaz
MOVF SAY3,W
ADDLW D'48'
CALL karakteryaz
RETURN


komutyaz
MOVWF ARA
SWAPF ARA,W
ANDLW 0X0F
MOVWF PORTD
BCF PORTB,0 ;rS 
BSF PORTB,1
CALL GECIKME
BCF PORTB,1


MOVF ARA,W
ANDLW 0X0F
MOVWF PORTD
BCF PORTB,0
BSF PORTB,1
CALL GECIKME
BCF PORTB,1

RETURN


karakteryaz
MOVWF ARA
SWAPF ARA,W
ANDLW 0X0F
MOVWF PORTD
BSF PORTB,0 ;RS
BSF PORTB,1
CALL GECIKME
BCF PORTB,1


MOVF ARA,W
ANDLW 0X0F
MOVWF PORTD
BSF PORTB,0
BSF PORTB,1
CALL GECIKME
BCF PORTB,1

RETURN



GECIKME
MOVLW D'255'
MOVWF ZAMAN
DECFSZ ZAMAN,F
GOTO $-1
RETURN

END