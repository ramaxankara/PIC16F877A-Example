INCLUDE<P16F877A.INC>


SAYAC EQU 0X23
BIRLER EQU 0X24
ONLAR EQU 0X25
SAY EQU 0X26

ORG 0X00
GOTO ANAPROGRAM
ORG	0X04
KESME
BTFSS PIR1,TMR1IF
RETFIE
BCF PIR1,TMR1IF
MOVLW H'3C'
MOVWF TMR1H
MOVLW H'B0'
MOVWF TMR1L

INCF SAYAC,F
MOVF SAYAC,W
SUBLW D'5'
BTFSS STATUS,Z
RETFIE
CLRF SAYAC
INCF BIRLER,F
MOVF BIRLER,W
SUBLW D'10'
BTFSS STATUS,Z
RETFIE
INCF ONLAR,F
CLRF BIRLER
RETFIE




ANAPROGRAM
BANKSEL TRISB
CLRF TRISB
CLRF TRISC
BANKSEL PORTB
CLRF PORTB
CLRF SAYAC
BANKSEL T1CON
BCF T1CON,T1CKPS0
BSF T1CON,T1CKPS1
BSF T1CON,TMR1ON
BANKSEL TMR1H
MOVLW H'3C'
MOVWF TMR1H
MOVLW H'B0'
MOVWF TMR1L
BANKSEL PIR1
BCF PIR1,TMR1IF
BANKSEL PIE1
BSF INTCON,GIE
BSF INTCON,PEIE
BSF PIE1,TMR1IE
BANKSEL PORTB


SONSUZ
MOVLW D'1'
MOVWF PORTC
MOVF BIRLER,W
CALL LOOKTABLE
MOVWF PORTB
CALL GECIKME
MOVLW D'2'
MOVWF PORTC
MOVF ONLAR,W
CALL LOOKTABLE
MOVWF PORTB
CALL GECIKME
GOTO SONSUZ




LOOKTABLE
ADDWF PCL,F
RETLW B'00111111'  ;0  
RETLW B'00000110'  ;1
RETLW B'01011011'  ;2
RETLW B'01001111'  ;3
RETLW B'01100110'  ;4
RETLW B'01101101'  ;5
RETLW B'01111101'  ;6
RETLW B'00000111'  ;7
RETLW B'01111111'  ;8
RETLW B'01101111'  ;9
RETURN


GECIKME
MOVLW D'100'
MOVWF SAY
DECFSZ SAY,F
GOTO $-1
RETURN


END