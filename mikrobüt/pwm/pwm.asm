INCLUDE<P16F877A.INC>
__config H'3F31'

SAY1 EQU 0X23
SAY2 EQU 0X24


ORG 0X00
goto anaprogram
ORG 0X04
KESME



anaprogram
BANKSEL TRISA
MOVLW 0x06
MOVWF ADCON1
MOVLW 0XCF
MOVWF TRISA
CLRF TRISC

BANKSEL INTCON
BSF INTCON,GIE
BSF INTCON,PEIE
BANKSEL T2CON
BSF T2CON,T2CKPS0
BCF T2CON,T2CKPS1     ;TMR2 PRESCALER 1:4
BSF T2CON,TMR2ON
BANKSEL PR2
MOVLW D'199'			;Periyod 800 mikrosaniye ayarlandý
MOVWF PR2		

BANKSEL CCP1CON
MOVLW 0X0C			;00001100 	ATANDI
MOVWF CCP1CON
MOVLW B'00110010'   ;200 DENK GELIO 10 BÝT
MOVWF CCPR1L		;DUTYCYCLE = %25


KONTROLET
BTFSC PORTA,0
GOTO  MARTIR
GOTO  KONTROLET


MARTIR
MOVF CCPR1L,W
SUBLW D'200'
BTFSC STATUS,Z
RETURN
MOVLW D'5'
ADDWF CCPR1L,F		
GOTO SONSUZ
RETURN


SONSUZ
BTFSS PORTA,0
GOTO KONTROLET
GOTO SONSUZ

GECIKME
MOVLW 0XFF
MOVWF SAY1		;BUTON ARK OLAYI ICIN

GECIKME2
MOVLW 0XFF
MOVWF SAY2
DECFSZ SAY2,F
GOTO $-1
DECFSZ SAY1,F
GOTO GECIKME2
RETURN



END