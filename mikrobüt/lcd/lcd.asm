#INCLUDE<P16F877A.INC>
__config H'3F31'


SAYAC1 EQU 0X23
SAYAC2 EQU 0X24
ZAMAN1 EQU 0X25
ZAMAN2 EQU 0X26
TEMP EQU 0X27
BASAMAKY EQU 0X28
BASAMAKO EQU 0X29
BASAMAKB EQU 0X30

ORG 0X00
ANAPROGRAM
BANKSEL TRISA
MOVLW D'255'
MOVWF TRISA
BANKSEL ADCON1
MOVLW B'00000000'
MOVWF ADCON1
BANKSEL TRISB
CLRF TRISB
CLRF TRISC
BANKSEL PORTB
CLRF PORTB
CLRF PORTC
CLRF SAYAC1
CLRF SAYAC2

CALL TEMIZLE
CALL YAZ

SONSUZ
GOTO SONSUZ




KONTROL
BANKSEL ADCON0
MOVLW B'00101001'
MOVWF ADCON0
BSF ADCON0,GO

BTFSC ADCON0,GO
GOTO $-1
BANKSEL ADRESH
MOVF ADRESH,W
MOVWF TEMP
CALL BASAMAKBULMA
GOTO KONTROL



BASAMAKBULMA
CLRF BASAMAKY
CLRF BASAMAKB
CLRF BASAMAKO

YUZLER
MOVLW D'100'
SUBWF TEMP,F
BTFSS STATUS,C
GOTO ONLAR
INCF BASAMAKY,F
GOTO YUZLER

ONLAR
MOVLW D'100'
ADDWF TEMP,F

ONLAR2
MOVLW D'10'
SUBWF TEMP,F
BTFSS STATUS,C
GOTO BIRLER
INCF BASAMAKO,F
GOTO ONLAR2

BIRLER
MOVLW D'10'
ADDWF TEMP,F
MOVF TEMP,W
MOVWF BASAMAKB



ANALOGYAZ
MOVLW 0X80
CALL KOMUTYAZ
BANKSEL PORTC
MOVF BASAMAKY,W
ADDLW D'48'
CALL KARAKTERYAZ
MOVLW 0X81
CALL KOMUTYAZ
BANKSEL PORTC
MOVF BASAMAKO,W
ADDLW D'48'
CALL KARAKTERYAZ
MOVLW 0X82
CALL KOMUTYAZ
BANKSEL PORTC
MOVF BASAMAKB,W
ADDLW D'48'
CALL KARAKTERYAZ
RETURN


TEMIZLE
MOVLW 0X02
CALL KOMUTYAZ
MOVLW 0X38
CALL KOMUTYAZ
MOVLW 0X0C
CALL KOMUTYAZ
RETURN


YAZ
BANKSEL PORTC
MOVF SAYAC1,W
CALL LOOKUP
CALL KARAKTERYAZ
INCF SAYAC1,F
MOVF SAYAC1,W
SUBLW D'7'
BTFSS STATUS,Z
GOTO YAZ
MOVLW 0XC0
CALL KOMUTYAZ

YAZ2
MOVF SAYAC2,W
CALL LOOKUP2
CALL KARAKTERYAZ
INCF SAYAC2,F
MOVF SAYAC2,W
SUBLW D'5'
BTFSS STATUS,Z
GOTO YAZ2
RETURN



KOMUTYAZ
BANKSEL PORTC
MOVWF PORTC
BCF PORTB,4
BSF PORTB,6
CALL GECIKME
BCF PORTB,6
RETURN

KARAKTERYAZ
BANKSEL PORTC
MOVWF PORTC
BSF PORTB,4
BSF PORTB,6
CALL GECIKME
BCF PORTB,6
RETURN



LOOKUP
ADDWF PCL,F
RETLW 'I'
RETLW 'B'
RETLW 'R'
RETLW 'A'
RETLW 'H'
RETLW 'I'
RETLW 'M'
RETURN

LOOKUP2
ADDWF PCL,F
RETLW 'D'
RETLW 'U'
RETLW 'Y'
RETLW 'G'
RETLW 'U'

RETURN






GECIKME
MOVLW D'255'
MOVWF ZAMAN1
GECIKME2
MOVLW D'255'
MOVWF ZAMAN2
GECIK
DECFSZ ZAMAN2,F
GOTO $-1
DECFSZ ZAMAN1,F
GOTO GECIKME2
RETURN









END