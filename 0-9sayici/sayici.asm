INCLUDE <P16F877A.INC>

SAY EQU 0X23
ZAMAN1 EQU 0X24
ZAMAN2 EQU 0X25

ORG 0X00
GOTO anaprogram
ORG 0X04
KESME
RETFIE


anaprogram
BANKSEL TRISB
CLRF TRISB
BANKSEL PORTB
CLRF PORTB
CLRF SAY


KONTROL
MOVF SAY,W
SUBLW D'10'
BTFSC STATUS,Z
GOTO SIFIRLA
MOVF SAY,W
CALL LOOKUP
MOVWF PORTB
CALL GECIKME
INCF SAY,F
GOTO KONTROL

SIFIRLA
MOVLW D'0'
MOVWF SAY
GOTO KONTROL




LOOKUP
ADDWF PCL,F
RETLW B'00111111'  ;0  
RETLW B'00000110'  ;1
RETLW B'01011011'  ;2
RETLW B'01001111'  ;3
RETLW B'01100110'  ;4
RETLW B'01101101'  ;5
RETLW B'01111101'  ;6
RETLW B'00000111'  ;7
RETLW B'01111111'  ;8
RETLW B'01101111'  ;9
RETURN




GECIKME
MOVLW D'255'
MOVWF ZAMAN1

GECIKME1
MOVLW D'255'
MOVWF ZAMAN2

GECIKME2
DECFSZ ZAMAN2,F
GOTO $-1
DECFSZ ZAMAN1,F
GOTO GECIKME1
RETURN




END